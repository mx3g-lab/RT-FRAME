## src/lib/sd_bench/Kconfig
```kconfig
menuconfig RTFRAME_SD_BENCH
	bool "SD card benchmark shell command"
	default n
	depends on SHELL && FILE_SYSTEM && FAT_FILESYSTEM_ELM
	help
	  Enable the 'sd_bench' shell command for measuring SD card
	  read/write throughput and worst-case block latency.
	  Uses POSIX file I/O (open/write/read/close/fsync/unlink).
```

## src/lib/timesync/Kconfig
```kconfig
config RTFRAME_TIMESYNC
    bool "Time synchronization library"
    default y
    depends on RTFRAME_HRT
    help
      Time synchronization between local and remote systems.
      Implements exponential filtering for clock offset/skew estimation.
```

## src/lib/tinybson/Kconfig
```kconfig
menuconfig RTFRAME_TINYBSON
	bool "TinyBSON library"
	default n
	depends on POSIX_API || ARCH_POSIX
	help
	  Enable the TinyBSON serialization library.
	  Requires POSIX file I/O (open/read/write/lseek/fsync).
```

## src/lib/tunes/Kconfig
```kconfig
config RTFRAME_TUNES
    bool "Tune playback library"
    default y
    depends on RTFRAME_CIRCUIT_BREAKER && RTFRAME_UORB
    help
      Melody/tune playback library with queue management.
      Parses tune strings (GWBasic/QBasic syntax).
```

## src/lib/variable_length_ringbuffer/Kconfig
```kconfig
config RTFRAME_VARIABLE_LENGTH_RINGBUFFER
	bool "Variable-length ring buffer library"
	default y
	help
	  Enable the variable-length ring buffer implementation,
	  supporting elements of varying sizes in a single buffer.
```

## src/lib/version/Kconfig
```kconfig
config RTFRAME_VERSION
    bool "Version library"
    default y
    help
      System version detection and reporting with git integration.
      Provides build URI, firmware version, git branch/tag information,
      and board hardware version.
```

## src/middleware/Kconfig
```kconfig
menu "Middleware"

config RTFRAME_MIDDLEWARE
    bool "Enable RTFrame middleware"
    default y
    help
      Master switch for all RTFrame middleware (uORB, zbus).

rsource "uorb/Kconfig"
rsource "zbus/Kconfig"

endmenu # Middleware
```

## src/middleware/uorb/Kconfig
```kconfig
menu "uORB"

config RTFRAME_UORB
	bool "uORB message bus"
	default n
	help
	  PX4-style publish/subscribe message bus.

if RTFRAME_UORB
rsource "uORB/Kconfig"
endif

endmenu # uORB
```

## src/middleware/uorb/uORB/Kconfig
```kconfig
config UORB_SUBSCRIBE_HANDLE_MAX
	int "Maximum concurrent orb_subscribe handles"
	default 64
	range 8 256
	help
	  Maximum number of simultaneous fd-style subscriptions (orb_subscribe).
	  Each slot uses sizeof(Subscription) bytes on the heap.
```

## src/middleware/zbus/Kconfig
```kconfig
menu "zbus"

config RTFRAME_ZBUS
	bool "zbus message bus"
	default n
	select ZBUS
	help
	  Zephyr native zbus publish/subscribe message bus.

endmenu # zbus
```

## src/modules/Kconfig
```kconfig
menu "Modules"

config RTFRAME_MODULES
    bool "Enable RTFrame modules"
    default y
    help
      Master switch for all RTFrame application modules (logger,
      param_loader, tests).

rsource "logger/Kconfig"
rsource "param_loader/Kconfig"
rsource "tests/Kconfig"
rsource "dataman/Kconfig"

endmenu # Modules
```

## src/modules/dataman/Kconfig
```kconfig
config RTFRAME_DATAMAN
	bool "dataman persistent storage module"
	default n
	---help---
		Enable support for dataman


menuconfig RTFRAME_DATAMAN_PERSISTENT_STORAGE
	bool "dataman supports persistent storage"
	default n
	depends on RTFRAME_DATAMAN
	---help---
		Dataman supports reading/writing to persistent storage


config RTFRAME_DATAMAN_MAX_MISSION_ITEMS
	int "Maximum number of mission items"
	default 500
	depends on RTFRAME_DATAMAN
	---help---
		This limit always applies if mission items are stored on the SD card or in RAM. It should be set
		adequately per boards such that if the items are stored in RAM they still fit the available memory.
		The runtime parameter to configure the storage option is `SYS_DM_BACKEND`.
```

## src/modules/logger/Kconfig
```kconfig
config RTFRAME_LOGGER
	bool "ULog logger"
	default n
	depends on RTFRAME_PARAM
	help
	  Enable the ULog data logger. Writes binary ULog files to SD card
	  (/SD:/log/). Requires the parameter system and file system.
```

## src/modules/mavlink_new/Kconfig
```kconfig
menuconfig RTFRAME_MAVLINK
    bool "MAVLink communication module"
    default n
    depends on RTFRAME_MODULES && RTFRAME_UORB
    help
      Enable MAVLink v2.0 communication module. Provides serial (UART)
      and optionally UDP transport for MAVLink telemetry, commands,
      parameters, and mission protocol.

if RTFRAME_MAVLINK

config RTFRAME_MAVLINK_DIALECT
    string "MAVLink dialect"
    default "common"
    help
      MAVLink XML dialect to generate C headers from.
      Options: common, ardupilotmega, etc.

config RTFRAME_MAVLINK_FTP
    bool "MAVLink FTP protocol"
    default n
    help
      Remote file system access via MAVLink FTP.

config RTFRAME_MAVLINK_EVENTS
    bool "MAVLink Events protocol"
    default n
    help
      EVENT and CURRENT_SEQUENCE message support.

config RTFRAME_MAVLINK_ULOG
    bool "MAVLink ULog streaming"
    default n
    help
      Stream ULog data over MAVLink LOGGING_DATA messages.

config RTFRAME_MAVLINK_MISSION
    bool "MAVLink Mission protocol"
    default n
    depends on RTFRAME_DATAMAN
    help
      Mission upload/download via MAVLink MISSION_ITEM protocol.

config RTFRAME_MAVLINK_ODID
    bool "Open Drone ID support"
    default n
    help
      Open Drone ID MAVLink message translation.

config RTFRAME_MAVLINK_TUNES
    bool "Tune playback support"
    default n
    help
      PLAY_TUNE / PLAY_TUNE_V2 MAVLink message handling.

endif # RTFRAME_MAVLINK
```

## src/modules/param_loader/Kconfig
```kconfig
menuconfig RTFRAME_PARAM_LOADER
	bool "Parameter loader module"
	default n
	depends on RTFRAME_PARAM && FILE_SYSTEM && POSIX_API
	help
	  Enable the parameter loader module which reads/writes parameters
	  from the SD card at startup. Requires FILE_SYSTEM and POSIX_API.
```

## src/modules/tests/Kconfig
```kconfig
menu "Tests"

config RTFRAME_TESTS
    bool "Enable RTFrame test modules"
    default n
    help
      Master switch for all RTFrame test modules (sdcard, perf,
      ringbuffer, param, demo_pub, demo_sub).

rsource "sdcard/Kconfig"
rsource "perf/Kconfig"
rsource "ringbuffer/Kconfig"
rsource "param/Kconfig"
rsource "demo_pub/Kconfig"
rsource "demo_sub/Kconfig"

endmenu # Tests
```

## src/modules/tests/demo_pub/Kconfig
```kconfig
menuconfig RTFRAME_DEMO_PUB
	bool "uORB demo publisher"
	default n
	depends on RTFRAME_UORB
	help
	  Enable the uORB demo publisher module.
```

## src/modules/tests/demo_sub/Kconfig
```kconfig
menuconfig RTFRAME_DEMO_SUB
	bool "uORB demo subscriber"
	default n
	depends on RTFRAME_UORB
	help
	  Enable the uORB demo subscriber module.
```

## src/modules/tests/param/Kconfig
```kconfig
menuconfig RTFRAME_TEST_PARAM
	bool "Parameter system test"
	default n
	depends on RTFRAME_PARAM && SHELL
	help
	  Enable the parameter system test module.
```

## src/modules/tests/perf/Kconfig
```kconfig
menuconfig RTFRAME_TEST_PERF
	bool "Performance counter test"
	default n
	depends on SHELL
	help
	  Enable the performance counter test module.
```

## src/modules/tests/ringbuffer/Kconfig
```kconfig
menuconfig RTFRAME_TEST_RINGBUFFER
	bool "Ring buffer test"
	default n
	depends on SHELL
	help
	  Enable the ring buffer test module.
```

## src/modules/tests/sdcard/Kconfig
```kconfig
menuconfig RTFRAME_TEST_SDCARD
	bool "SD card test module"
	default n
	depends on POSIX_API && FILE_SYSTEM && FAT_FILESYSTEM_ELM
	help
	  Enable the SD card read/write test module.
	  Requires POSIX file I/O and FAT filesystem support.
```
