## boards/nxp/vmu_rt1170/vmu_rt1170_mimxrt1176_cm4_defconfig
```kconfig
#
# Copyright 2026 NXP
# SPDX-License-Identifier: Apache-2.0
#

CONFIG_CONSOLE=y
CONFIG_UART_CONSOLE=y
CONFIG_SERIAL=y
CONFIG_GPIO=y

# CM4 core; keep minimal for hello_world.

# Added by sync_defconfig
CONFIG_UORB_SUBSCRIBE_HANDLE_MAX=64
```

## boards/nxp/vmu_rt1170/vmu_rt1170_mimxrt1176_cm7_defconfig
```kconfig
#
# Copyright (c) 2021, NXP
#
# SPDX-License-Identifier: Apache-2.0
#

CONFIG_CONSOLE=y
CONFIG_SHELL=y
CONFIG_UART_CONSOLE=y
CONFIG_SERIAL=y
CONFIG_GPIO=y
CONFIG_ARM_MPU=y
CONFIG_HW_STACK_PROTECTION=y
CONFIG_FLEXSPI_CONFIG_BLOCK_OFFSET=0x400

# Enable Regulators
CONFIG_REGULATOR=y
CONFIG_REGULATOR_FIXED_INIT_PRIORITY=65

# Sensor RTIO DMA config
# CONFIG_SPI_NXP_LPSPI_DMA is not set
# CONFIG_SPI_NXP_LPSPI_CPU_RTIO is not set

CONFIG_TICKLESS_KERNEL=y

# Added by sync_defconfig
CONFIG_RTFRAME_USB_CDC_MANUFACTURER="RTFrame"
CONFIG_RTFRAME_USB_CDC_MAX_POWER=125
CONFIG_RTFRAME_USB_CDC_PID=0x0001
CONFIG_RTFRAME_USB_CDC_PRODUCT="RTFrame CM7"
CONFIG_RTFRAME_USB_CDC_VID=0x2fe3
CONFIG_UORB_SUBSCRIBE_HANDLE_MAX=64

# Added by sync_defconfig
CONFIG_RTFRAME_CRC=y
CONFIG_RTFRAME_HEATSHRINK=y
CONFIG_RTFRAME_HRT=y
CONFIG_RTFRAME_LOG=y
CONFIG_RTFRAME_MATHLIB=y
CONFIG_RTFRAME_MATRIX=y
CONFIG_RTFRAME_PERF=y
CONFIG_RTFRAME_RINGBUFFER=y
```

## src/Kconfig
```kconfig
menu "RTFrame"

rsource "core/Kconfig"
rsource "lib/Kconfig"
rsource "drivers/Kconfig"
rsource "modules/Kconfig"
rsource "middleware/Kconfig"

endmenu # RTFrame
```

## src/core/Kconfig
```kconfig
menu "Core"

config RTFRAME_CORE
    bool "RTFrame core runtime"
    default y
    help
      Enable the RTFrame core runtime including work queue manager
      and task self-registration system. Required by all other modules.

endmenu # Core
```

## src/drivers/Kconfig
```kconfig
menu "Drivers"

config RTFRAME_DRIVERS
    bool "Enable RTFrame drivers"
    default y
    help
      Master switch for all RTFrame drivers (USB CDC-ACM).

rsource "usb/Kconfig"

endmenu # Drivers
```

## src/drivers/usb/Kconfig
```kconfig
menu "USB"

config RTFRAME_USB_CDC
	bool "USB CDC-ACM virtual serial port"
	depends on USB_DEVICE_STACK_NEXT && USBD_CDC_ACM_CLASS
	default n
	help
	  Initialize a USB CDC-ACM virtual serial port at boot.

if RTFRAME_USB_CDC

config RTFRAME_USB_CDC_VID
	hex "USB Vendor ID"
	default 0x2fe3

config RTFRAME_USB_CDC_PID
	hex "USB Product ID"
	default 0x0001

config RTFRAME_USB_CDC_MANUFACTURER
	string "USB manufacturer string"
	default "RTFrame"

config RTFRAME_USB_CDC_PRODUCT
	string "USB product string"
	default "RTFrame CM7"

config RTFRAME_USB_CDC_MAX_POWER
	int "Max power (in 2mA units)"
	default 125
	range 0 250

endif # RTFRAME_USB_CDC

endmenu # USB
```

## src/lib/Kconfig
```kconfig
menu "Libraries"

config RTFRAME_LIB
    bool "Enable optional RTFrame libraries"
    default y
    help
      Master switch for optional RTFrame libraries (log, perf, ringbuffer,
      crc, heatshrink, mathlib, matrix, mavlink_log, console_buffer,
      parameters, sd_bench, tinybson). The hrt library is always compiled
      as it is required by the core runtime.

rsource "hrt/Kconfig"
rsource "log/Kconfig"
rsource "perf/Kconfig"
rsource "ringbuffer/Kconfig"
rsource "crc/Kconfig"
rsource "heatshrink/Kconfig"
rsource "mathlib/Kconfig"
rsource "matrix/Kconfig"
rsource "mavlink_log/Kconfig"
rsource "console_buffer/Kconfig"
rsource "parameters/Kconfig"
rsource "sd_bench/Kconfig"
rsource "tinybson/Kconfig"
rsource "version/Kconfig"
rsource "circuit_breaker/Kconfig"
rsource "atmosphere/Kconfig"
rsource "airspeed/Kconfig"
rsource "geo/Kconfig"
rsource "conversion/Kconfig"
rsource "timesync/Kconfig"
rsource "dataman_client/Kconfig"
rsource "adsb/Kconfig"
rsource "tunes/Kconfig"
rsource "variable_length_ringbuffer/Kconfig"

endmenu # Libraries
```

## src/lib/adsb/Kconfig
```kconfig
config RTFRAME_ADSB
    bool "ADSB conflict detection library"
    default y
    depends on RTFRAME_GEO && RTFRAME_HRT && RTFRAME_UORB
    help
      ADSB conflict detection and collision avoidance.
      Manages traffic data buffers and calculates conflict warnings.
```

## src/lib/airspeed/Kconfig
```kconfig
config RTFRAME_AIRSPEED
    bool "Airspeed calculation library"
    default y
    depends on RTFRAME_ATMOSPHERE
    help
      Airspeed estimation from pitot/static pressure sensors.
      Calculates IAS and TAS with compensation for sensor types.
```

## src/lib/atmosphere/Kconfig
```kconfig
config RTFRAME_ATMOSPHERE
    bool "Atmosphere model library"
    default y
    help
      US Standard Atmosphere 1976 model for density, pressure,
      and altitude conversions up to 11km altitude.
```

## src/lib/circuit_breaker/Kconfig
```kconfig
config RTFRAME_CIRCUIT_BREAKER
    bool "Circuit breaker library"
    default y
    depends on RTFRAME_PARAM
    help
      Circuit breaker functionality for disabling safety checks.
      Safety warning: Circuit breakers should only be used during
      testing and debugging. Do not use in production flight.
```

## src/lib/console_buffer/Kconfig
```kconfig
config RTFRAME_CONSOLE_BUFFER
	bool "Console ring-buffer"
	default n
	help
	  Enable console output ring-buffer for deferred log retrieval.
```

## src/lib/conversion/Kconfig
```kconfig
config RTFRAME_CONVERSION
    bool "Vector rotation library"
    default y
    depends on RTFRAME_MATHLIB && RTFRAME_MATRIX
    help
      Vector rotation library for coordinate frame transformations.
      Defines 32+ rotation types and provides transformation functions.
```

## src/lib/crc/Kconfig
```kconfig
config RTFRAME_CRC
	bool "CRC library"
	default y
	help
	  Enable CRC-8 / CRC-16 / CRC-32 computation utilities.
```

## src/lib/dataman_client/Kconfig
```kconfig
config RTFRAME_DATAMAN_CLIENT
    bool "Dataman client library"
    default y
    depends on RTFRAME_HRT
    help
      Client interface for dataman storage service.
      Provides sync/async read/write/clear operations with timeout.
      Note: Requires dataman module to be functional.
```

## src/lib/geo/Kconfig
```kconfig
config RTFRAME_GEO
    bool "Geodetic calculation library"
    default y
    depends on RTFRAME_MATHLIB && RTFRAME_MATRIX
    help
      Geodetic calculations and coordinate transformations.
      Provides waypoint distance/bearing, map projection (lat/lon to NED),
      and crosstrack error calculations.
```

## src/lib/heatshrink/Kconfig
```kconfig
config RTFRAME_HEATSHRINK
	bool "Heatshrink compression library"
	default y
	help
	  Enable the Heatshrink LZSS compression/decompression library.
```

## src/lib/hrt/Kconfig
```kconfig
config RTFRAME_HRT
	bool "High-resolution timer (HRT)"
	default y
	help
	  Enable the high-resolution timer library used by the rtframe core.
```

## src/lib/log/Kconfig
```kconfig
config RTFRAME_LOG
	bool "RTFrame log wrapper"
	default y
	help
	  Enable the PX4-style log wrapper (PX4_INFO / PX4_ERR / PX4_WARN).
```

## src/lib/mathlib/Kconfig
```kconfig
config RTFRAME_MATHLIB
	bool "Math utility library"
	default y
	help
	  Enable math helper utilities (limits, filters, etc.).
```

## src/lib/matrix/Kconfig
```kconfig
config RTFRAME_MATRIX
	bool "Matrix math library"
	default y
	help
	  Enable the header-only matrix / quaternion math library.
```

## src/lib/mavlink_log/Kconfig
```kconfig
config RTFRAME_MAVLINK_LOG
	bool "MAVLink log publisher"
	default n
	depends on RTFRAME_UORB
	help
	  Enable MAVLink log message publishing over uORB.
```

## src/lib/parameters/Kconfig
```kconfig
menuconfig RTFRAME_PARAM
	bool "Parameter system"
	default n
	help
	  Enable the PX4-compatible parameter system with BSON file storage.

if RTFRAME_PARAM

config PARAM_PRIMARY
	bool "Parameter primary node"
	default n
	help
	  Enable support for the parameter primary in distributed board
	  architectures (e.g. CM7 as primary, CM4 as remote).

config PARAM_REMOTE
	bool "Parameter remote node"
	default n
	help
	  Enable support for the parameter remote in distributed board
	  architectures (e.g. CM4 as remote, CM7 as primary).

endif # RTFRAME_PARAM
```

## src/lib/perf/Kconfig
```kconfig
config RTFRAME_PERF
	bool "Performance counter library"
	default y
	help
	  Enable lightweight performance counters for timing and event counting.
```

## src/lib/ringbuffer/Kconfig
```kconfig
config RTFRAME_RINGBUFFER
	bool "Ring buffer library"
	default y
	help
	  Enable the lock-free ring buffer implementation.
```
